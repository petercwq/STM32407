#include "hs0038.h"

/*********************************************************************************
**************************MCU启明 STM32F407应用开发板*****************************
**********************************************************************************
* 文件名称: hs0038.c                                                             *
* 文件简述：红外接收管使用                                                       *
* 创建日期：2015.03.17                                                           *
* 版    本：V1.0                                                                 *
* 作    者：Clever                                                               *
* 说    明：                                                                     * 
**********************************************************************************
*********************************************************************************/

u8  Ir_Time,IR_flag;//红外用全局变量

u8 Decode_OK,Recive_OK,IR_OK;//定义接收状态、解码状态
u8 Ir_Record[4];    //处理后的红外码，分别是 客户码，客户码，数据码，数据码反码
u8 Ir_TimeData[33]; //33个高低电平的时间数据gfaaeg awgGww



/****************************************************************************
* 名    称: void Ir_Decode(void)
* 功    能：红外解码函数处理
* 入口参数：无
* 返回参数：无
* 说    明：Ir_Record[4]; 处理后的红外码，分别是 客户码，客户码，数据码，数据码反码 
****************************************************************************/
void Ir_Decode(void) 
{ 
  u8 i, j, k;
  u8 Record,Value;
	
  IR_OK = 1;
  k = 1;
	
  for(i = 0;i < 4;i++)          //处理4个字节
     {
				delay_ms(1);
				for(j = 1;j <= 8;j++)   //处理1个字节8位
					 {
							Record = Ir_TimeData[k];
							if(Record >7)     //大于某值为1，这个和晶振有绝对关系，这里使用12M计算，此值可以有一定误差
						    {
								  Value = Value|0x80;
						    }
							else 
						    {
								  Value = Value;
					      }
							if(j < 8)
						    {
					        Value = Value >>1;
					      }
							k++;
					 }
				   Ir_Record[i] = Value;
				   Value = 0;    
     } 
	   Decode_OK = 1;//处理完毕标志位置1 
}

/******************************************************************/
//红外键值显示处理 
/******************************************************************/

//   void Ir_KeyDisp(void)        //红外键值散转程序
//   {
// 		switch(Ir_Record[2])//判断第三个数码值
// 	         {
// 				 case 0x45:WrString1602(0,2,"POWER");break;//0 显示相应的按键值
// 				 case 0x46:WrString1602(0,2,"MODE");break;//1 显示相应的按键值
// 				 case 0x47:WrString1602(0,2,"SILENT");break;//2
// 				 case 0x44:WrString1602(0,2,"PAUSE");break;//3
// 				 case 0x40:WrString1602(0,2,"BACK");break;//4
// 				 case 0x43:WrString1602(0,2,"ADVANCE");break;//5
// 				 case 0x07:WrString1602(0,2,"EQ");break;//6
// 				 case 0x15:WrString1602(0,2,"VOL-");break;//7
// 				 case 0x09:WrString1602(0,2,"VOL+");break;//8
// 				 case 0x16:WrByte1602(0,2,'0');break;//0 显示相应的按键值
// 				 case 0x0c:WrByte1602(0,2,'1');break;//1 显示相应的按键值
// 				 case 0x18:WrByte1602(0,2,'2');break;//2
// 				 case 0x5e:WrByte1602(0,2,'3');break;//3
// 				 case 0x08:WrByte1602(0,2,'4');break;//4
// 				 case 0x1c:WrByte1602(0,2,'5');break;//5
// 				 case 0x5a:WrByte1602(0,2,'6');break;//6
// 				 case 0x42:WrByte1602(0,2,'7');break;//7
// 				 case 0x52:WrByte1602(0,2,'8');break;//8
// 				 case 0x4a:WrByte1602(0,2,'9');break;//9
// 		         default:break;
// 			 }       
// 	  Decode_OK = 0;          //处理完成后清除标志位
//   }

