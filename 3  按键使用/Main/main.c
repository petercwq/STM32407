#include "led.h"
#include "beep.h"
#include "key.h"

/*********************************************************************************
**********************MCU启明 STM32F407应用开发板(高配版)*************************
**********************************************************************************
* 文件名称: 例程3 按键使用主函数main()                                           *
* 文件简述：按键实验                                                             *
* 创建日期：2017.08.30                                                           *
* 版    本：V1.0                                                                 *
* 作    者：Clever                                                               *
* 说    明：按键控制LED亮灭与蜂鸣器开断                                          *
* 淘宝店铺：https://shop125046348.taobao.com                                     *
* 声    明：本例程代码仅用于学习参考                                             *
**********************************************************************************
*********************************************************************************/

int main(void)
{ 

	delay_init();     //延时函数初始化
	LED_Init();				//LED初始化
	BEEP_Init();      //蜂鸣器初始化
	KEY_Init();       //按键初始化

	while(1)
	{
		key_scan(0);	

		if(keydown_data==KEY0_DATA)   //key0按下后马上执行相应代码
		{
		  LED0=0;
			LED1=0;
			LED2=0;
		}
		if(keyup_data==KEY1_DATA)     //key1按下抬起之后执行相应代码
		{
			 BEEP=1;
		}
		if(key_tem==KEY2_DATA && key_time>200)  //key2长按1秒后执行相应代码 由于延时5ms扫描一次按键所以5ms*200=1S
		{
			 BEEP=0;
			 LED0=1;
		}
		if(key_tem==KEY3_DATA && key_time>400)  //key3长按2秒后执行相应代码 由于延时5ms扫描一次按键所以5ms*400=2S
		{
			 LED1=1;
			 LED2=1;
		}
    delay_ms(5);
	}
}

